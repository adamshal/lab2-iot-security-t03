## CMakeLists.txt
```
# SPDX-License-Identifier: Apache-2.0

cmake_minimum_required(VERSION 3.20.0)

find_package(Zephyr REQUIRED HINTS $ENV{ZEPHYR_BASE})
project(lora_encrypted_client)

# Arduino Crypto library (git submodule in ../Crypto)
set(CRYPTO_DIR "${CMAKE_CURRENT_SOURCE_DIR}/../Crypto/src" CACHE PATH "Arduino Crypto library sources")

set(crypto_sources
  ${CRYPTO_DIR}/AES128.cpp
  ${CRYPTO_DIR}/AESCommon.cpp
  ${CRYPTO_DIR}/BigNumberUtil.cpp
  ${CRYPTO_DIR}/BlockCipher.cpp
  ${CRYPTO_DIR}/Crypto.cpp
  ${CRYPTO_DIR}/Curve25519.cpp
  ${CRYPTO_DIR}/Ed25519.cpp
  ${CRYPTO_DIR}/Hash.cpp
  ${CRYPTO_DIR}/SHA256.cpp
  ${CRYPTO_DIR}/SHA512.cpp)

# The library's own RNG.h needs Arduino; shim/RNG.h replaces it (included first)
set_source_files_properties(${crypto_sources} PROPERTIES
  COMPILE_OPTIONS "-include;${CMAKE_CURRENT_SOURCE_DIR}/shim/RNG.h")

FILE(GLOB app_sources src/*.c src/*.cpp)
target_sources(app PRIVATE ${app_sources} ${crypto_sources})
target_include_directories(app PRIVATE shim ${CRYPTO_DIR})

# Shared wire protocol and radio application used by both endpoints.
target_sources(app PRIVATE ../common/sec_protocol.c)
target_include_directories(app PRIVATE ../common src)
```

## prj.conf
```kconfig
CONFIG_LOG=y
CONFIG_LORA=y
CONFIG_PRINTK=y

# Crypto wrapper and secure random source (lab setup)
CONFIG_CPP=y
CONFIG_STD_CPP17=y
CONFIG_ENTROPY_GENERATOR=y
CONFIG_CSPRNG_NEEDED=y
CONFIG_MAIN_STACK_SIZE=8192

# Driver receive timeouts are normal while waiting; retain warnings/errors.
CONFIG_LORA_LOG_LEVEL_WRN=y
```

## src/main.c
```c
/* Shared protocol; role and signing identity are endpoint-specific. */
#define IS_CLIENT true
#include "lora_app.h"
```

## src/identity.h
```c
/* Local lab provisioning; private seed excluded from Git. */
#include <stdint.h>
static const uint8_t identity_private[32] = {0x96,0x71,0x75,0x46,0xf5,0xe2,0x2d,0x47,0x5a,0x20,0x36,0x8d,0xa0,0x8c,0x3f,0x74,0xb4,0xc2,0xda,0x3e,0x9f,0xa7,0xc1,0x9e,0x97,0x10,0x41,0x25,0x8d,0x83,0xf7,0x6d};
static const uint8_t identity_public[32] = {0x58,0xd9,0x13,0xd4,0x03,0x6c,0x9c,0x0d,0xf0,0x4a,0xff,0x98,0x27,0xd1,0x9c,0xa8,0x21,0x6f,0x5a,0x96,0x91,0xf0,0x9f,0xc0,0x36,0x33,0xff,0x30,0xfb,0x64,0xd9,0x65};
static const uint8_t peer_public[32] = {0x7d,0x05,0x8e,0x89,0x0a,0xce,0x85,0xf1,0x8e,0x2d,0x32,0xce,0x6b,0x9d,0xf8,0x54,0x63,0x6c,0x66,0xd8,0x15,0x90,0x32,0x0a,0x35,0x3f,0xa2,0x38,0xa8,0x4f,0x99,0x73};
```
